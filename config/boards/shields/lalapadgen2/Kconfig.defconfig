## config/boards/shields/lalapadgen2/Kconfig.defconfig
```kconfig
if SHIELD_LALAPADGEN2_RIGHT

config ZMK_KEYBOARD_NAME
    default "LalapadGen2"

config ZMK_SPLIT_ROLE_CENTRAL
    default y

endif

if SHIELD_LALAPADGEN2_LEFT || SHIELD_LALAPADGEN2_RIGHT

config ZMK_SPLIT
    default y

endif
```
